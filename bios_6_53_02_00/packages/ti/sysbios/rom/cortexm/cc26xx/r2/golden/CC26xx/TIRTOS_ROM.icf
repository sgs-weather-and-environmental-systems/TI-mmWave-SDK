
place at address mem:0x00001300 {readonly section .const_xdc_runtime_Error_policy__C};
place at address mem:0x000012b8 {readonly section .const_xdc_runtime_IModule_Interface__BASE__C};
place at address mem:0x00001298 {readonly section .const_xdc_runtime_Startup_lastFxns__C};
place at address mem:0x00001130 {readonly section .const_ti_sysbios_knl_Event_Object__DESC__C};
place at address mem:0x000010b0 {readonly section .const_ti_sysbios_gates_GateMutex_Object__DESC__C};
place at address mem:0x00001310 {readonly section .const_ti_sysbios_rom_ROM_ti_sysbios_family_arm_cc26xx_Timer_initDevice__I};
place at address mem:0x000012c0 {readonly section .const_xdc_runtime_Startup_execImpl__C};
place at address mem:0x0000130c {readonly section .const_ti_sysbios_rom_ROM_ti_sysbios_family_arm_cc26xx_Timer_getMaxTicks__E};
place at address mem:0x0000125c {readonly section .const_ti_sysbios_knl_Swi_Object__count__C};
place at address mem:0x000011f0 {readonly section .const_ti_sysbios_knl_Idle_funcList__C};
place at address mem:0x000012fe {readonly section .const_xdc_runtime_Text_isLoaded__C};
place at address mem:0x00001110 {readonly section .const_ti_sysbios_knl_Clock_Object__DESC__C};
place at address mem:0x00001258 {readonly section .const_ti_sysbios_knl_Semaphore_eventSync__C};
place at address mem:0x0000104c {readonly section .const_ti_sysbios_gates_GateMutex_Module__FXNS__C};
place at address mem:0x00001284 {readonly section .const_ti_sysbios_family_arm_m3_Hwi_Module__id__C};
place at address mem:0x00001280 {readonly section .const_ti_sysbios_family_arm_cc26xx_Timer_Module__id__C};
place at address mem:0x00001244 {readonly section .const_ti_sysbios_knl_Mailbox_Object__table__C};
place at address mem:0x0000120c {readonly section .const_ti_sysbios_family_arm_m3_Hwi_Object__table__C};
place at address mem:0x000011b0 {readonly section .const_ti_sysbios_knl_Swi_Object__DESC__C};
place at address mem:0x000012fc {readonly section .const_xdc_runtime_Text_charCnt__C};
place at address mem:0x000012ac {readonly section .const_xdc_runtime_Error_raiseHook__C};
place at address mem:0x0000131c {readonly section .const_ti_sysbios_rom_ROM_ti_sysbios_family_arm_cc26xx_Timer_start__E};
place at address mem:0x00001234 {readonly section .const_ti_sysbios_heaps_HeapMem_Object__table__C};
place at address mem:0x000012a8 {readonly section .const_xdc_runtime_Error_policyFxn__C};
place at address mem:0x00001304 {readonly section .const_ti_sysbios_rom_ROM_ti_sysbios_family_arm_cc26xx_Timer_getCount64__E};
place at address mem:0x00001290 {readonly section .const_xdc_runtime_Startup_firstFxns__C};
place at address mem:0x000012e8 {readonly section .const_xdc_runtime_Text_charTab__C};
place at address mem:0x00001320 {readonly section .const_ti_sysbios_rom_ROM_ti_sysbios_family_arm_cc26xx_TimestampProvider_get32__E};
place at address mem:0x000012f8 {readonly section .const_xdc_runtime_Error_maxDepth__C};
place at address mem:0x00001308 {readonly section .const_ti_sysbios_rom_ROM_ti_sysbios_family_arm_cc26xx_Timer_getCurrentTick__E};
place at address mem:0x00001224 {readonly section .const_ti_sysbios_family_arm_m3_TaskSupport_stackAlignment__C};
place at address mem:0x00001204 {readonly section .const_ti_sysbios_family_arm_m3_Hwi_NUM_INTERRUPTS__C};
place at address mem:0x0000123c {readonly section .const_ti_sysbios_knl_Clock_triggerClock__C};
place at address mem:0x00001260 {readonly section .const_ti_sysbios_knl_Swi_Object__table__C};
place at address mem:0x000012fa {readonly section .const_xdc_runtime_Memory_Module__id__C};
place at address mem:0x0000122c {readonly section .const_ti_sysbios_heaps_HeapMem_Module__gateObj__C};
place at address mem:0x000011f8 {readonly section .const_ti_sysbios_family_arm_cc26xx_Timer_startupNeeded__C};
place at address mem:0x00001170 {readonly section .const_ti_sysbios_knl_Queue_Object__DESC__C};
place at address mem:0x000011d0 {readonly section .const_ti_sysbios_knl_Task_Object__DESC__C};
place at address mem:0x000012a0 {readonly section .const_xdc_runtime_Assert_E_assertFailed__C};
place at address mem:0x00001286 {readonly section .const_ti_sysbios_gates_GateHwi_Module__id__C};
place at address mem:0x000012b4 {readonly section .const_xdc_runtime_IHeap_Interface__BASE__C};
place at address mem:0x000012d8 {readonly section .const_xdc_runtime_SysCallback_exitFxn__C};
place at address mem:0x0000128a {readonly section .const_ti_sysbios_heaps_HeapMem_Module__id__C};
place at address mem:0x00001214 {readonly section .const_ti_sysbios_family_arm_m3_Hwi_excHandlerFunc__C};
place at address mem:0x00001000 {readonly section .const_ti_sysbios_heaps_HeapMem_Module__FXNS__C};
place at address mem:0x000012e4 {readonly section .const_xdc_runtime_System_maxAtexitHandlers__C};
place at address mem:0x0000124c {readonly section .const_ti_sysbios_knl_Queue_Object__count__C};
place at address mem:0x0000126c {readonly section .const_ti_sysbios_knl_Task_Object__table__C};
place at address mem:0x00001150 {readonly section .const_ti_sysbios_knl_Mailbox_Object__DESC__C};
place at address mem:0x00001218 {readonly section .const_ti_sysbios_family_arm_m3_Hwi_nullIsrFunc__C};
place at address mem:0x0000128e {readonly section .const_ti_sysbios_knl_Clock_tickMode__C};
place at address mem:0x00001288 {readonly section .const_ti_sysbios_gates_GateMutex_Module__id__C};
place at address mem:0x00001264 {readonly section .const_ti_sysbios_knl_Swi_numPriorities__C};
place at address mem:0x0000127c {readonly section .const_ti_sysbios_knl_Task_numConstructedTasks__C};
place at address mem:0x000012c4 {readonly section .const_xdc_runtime_Startup_maxPasses__C};
place at address mem:0x0000128c {readonly section .const_ti_sysbios_knl_Task_initStackFlag__C};
place at address mem:0x000012dc {readonly section .const_xdc_runtime_System_abortFxn__C};
place at address mem:0x00001028 {readonly section .const_ti_sysbios_gates_GateHwi_Module__FXNS__C};
place at address mem:0x000010d0 {readonly section .const_ti_sysbios_hal_Hwi_Object__DESC__C};
place at address mem:0x00001220 {readonly section .const_ti_sysbios_family_arm_m3_Hwi_priGroup__C};
place at address mem:0x000012a4 {readonly section .const_xdc_runtime_Error_E_memory__C};
place at address mem:0x000011fc {readonly section .const_ti_sysbios_family_arm_m3_Hwi_E_alreadyDefined__C};
place at address mem:0x00001250 {readonly section .const_ti_sysbios_knl_Queue_Object__table__C};
place at address mem:0x00001254 {readonly section .const_ti_sysbios_knl_Semaphore_eventPost__C};
place at address mem:0x000012e0 {readonly section .const_xdc_runtime_System_exitFxn__C};
place at address mem:0x00001314 {readonly section .const_ti_sysbios_rom_ROM_ti_sysbios_family_arm_cc26xx_Timer_setNextTick__E};
place at address mem:0x00001238 {readonly section .const_ti_sysbios_heaps_HeapMem_reqAlign__C};
place at address mem:0x000012c8 {readonly section .const_xdc_runtime_Startup_sfxnRts__C};
place at address mem:0x00001190 {readonly section .const_ti_sysbios_knl_Semaphore_Object__DESC__C};
place at address mem:0x00001090 {readonly section .const_ti_sysbios_gates_GateHwi_Object__DESC__C};
place at address mem:0x00001230 {readonly section .const_ti_sysbios_heaps_HeapMem_Object__count__C};
place at address mem:0x0000121c {readonly section .const_ti_sysbios_family_arm_m3_Hwi_numSparseInterrupts__C};
place at address mem:0x00001248 {readonly section .const_ti_sysbios_knl_Mailbox_maxTypeAlign__C};
place at address mem:0x00001282 {readonly section .const_ti_sysbios_family_arm_cc26xx_TimestampProvider_useClockTimer__C};
place at address mem:0x0000132c {readonly section .const_ti_sysbios_rom_ROM_xdc_runtime_System_SupportProxy_exit__E};
place at address mem:0x00001270 {readonly section .const_ti_sysbios_knl_Task_allBlockedFunc__C};
place at address mem:0x00001328 {readonly section .const_ti_sysbios_rom_ROM_xdc_runtime_System_SupportProxy_abort__E};
place at address mem:0x00001240 {readonly section .const_ti_sysbios_knl_Mailbox_Object__count__C};
place at address mem:0x000012f0 {readonly section .const_xdc_runtime_Text_nameStatic__C};
place at address mem:0x00001324 {readonly section .const_ti_sysbios_rom_ROM_xdc_runtime_Startup_getState__I};
place at address mem:0x00001278 {readonly section .const_ti_sysbios_knl_Task_defaultStackSize__C};
place at address mem:0x000012b0 {readonly section .const_xdc_runtime_IGateProvider_Interface__BASE__C};
place at address mem:0x00001200 {readonly section .const_ti_sysbios_family_arm_m3_Hwi_E_hwiLimitExceeded__C};
place at address mem:0x000012d0 {readonly section .const_xdc_runtime_Startup_startModsFxn__C};
place at address mem:0x00001070 {readonly section .const_ti_sysbios_family_arm_m3_Hwi_Object__DESC__C};
place at address mem:0x000012ec {readonly section .const_xdc_runtime_Text_nameEmpty__C};
place at address mem:0x00001208 {readonly section .const_ti_sysbios_family_arm_m3_Hwi_Object__count__C};
place at address mem:0x000012d4 {readonly section .const_xdc_runtime_SysCallback_abortFxn__C};
place at address mem:0x00001274 {readonly section .const_ti_sysbios_knl_Task_defaultStackHeap__C};
place at address mem:0x00001210 {readonly section .const_ti_sysbios_family_arm_m3_Hwi_ccr__C};
place at address mem:0x00001228 {readonly section .const_ti_sysbios_heaps_HeapMem_E_memory__C};
place at address mem:0x00001268 {readonly section .const_ti_sysbios_knl_Task_Object__count__C};
place at address mem:0x000010f0 {readonly section .const_ti_sysbios_heaps_HeapMem_Object__DESC__C};
place at address mem:0x000012f4 {readonly section .const_xdc_runtime_Text_nameUnknown__C};
place at address mem:0x000012bc {readonly section .const_xdc_runtime_Memory_defaultHeapInstance__C};
place at address mem:0x00001318 {readonly section .const_ti_sysbios_rom_ROM_ti_sysbios_family_arm_cc26xx_Timer_setThreshold__I};
place at address mem:0x000012cc {readonly section .const_xdc_runtime_Startup_sfxnTab__C};
place at address mem:0x20000178 {readwrite section .data_ti_sysbios_knl_Clock_Module__state__V};
place at address mem:0x200001ec {readwrite section .data_ti_sysbios_family_arm_cc26xx_TimestampProvider_Module__state__V};
place at address mem:0x200001f0 {readwrite section .data_xdc_runtime_Startup_Module__state__V};
place at address mem:0x200001a4 {readwrite section .data_ti_sysbios_BIOS_Module__state__V};
place at address mem:0x200001c8 {readwrite section .data_ti_sysbios_knl_Swi_Module__state__V};
place at address mem:0x20000100 {readwrite section .data_ti_sysbios_knl_Task_Module__state__V};
place at address mem:0x20000200 {readwrite section .data_xdc_runtime_Memory_Module__state__V};
place at address mem:0x200001f8 {readwrite section .data_xdc_runtime_System_Module__state__V};
place at address mem:0x20000144 {readwrite section .data_ti_sysbios_family_arm_m3_Hwi_Module__state__V};
place at address mem:0x20000204 {readwrite section .data_xdc_runtime_Error_Module__state__V};
place at address mem:0x200001e4 {readwrite section .data_ti_sysbios_family_arm_cc26xx_Timer_Module__state__V};
