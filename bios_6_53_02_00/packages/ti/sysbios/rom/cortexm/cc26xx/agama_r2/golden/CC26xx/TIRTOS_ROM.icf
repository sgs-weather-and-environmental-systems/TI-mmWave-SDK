
place at address mem:0x00002300 {readonly section .const_xdc_runtime_Error_policy__C};
place at address mem:0x000022b8 {readonly section .const_xdc_runtime_IModule_Interface__BASE__C};
place at address mem:0x00002298 {readonly section .const_xdc_runtime_Startup_lastFxns__C};
place at address mem:0x00002130 {readonly section .const_ti_sysbios_knl_Event_Object__DESC__C};
place at address mem:0x000020b0 {readonly section .const_ti_sysbios_gates_GateMutex_Object__DESC__C};
place at address mem:0x00002310 {readonly section .const_ti_sysbios_rom_ROM_ti_sysbios_family_arm_cc26xx_Timer_initDevice__I};
place at address mem:0x000022c0 {readonly section .const_xdc_runtime_Startup_execImpl__C};
place at address mem:0x0000230c {readonly section .const_ti_sysbios_rom_ROM_ti_sysbios_family_arm_cc26xx_Timer_getMaxTicks__E};
place at address mem:0x0000225c {readonly section .const_ti_sysbios_knl_Swi_Object__count__C};
place at address mem:0x000021f0 {readonly section .const_ti_sysbios_knl_Idle_funcList__C};
place at address mem:0x000022fe {readonly section .const_xdc_runtime_Text_isLoaded__C};
place at address mem:0x00002110 {readonly section .const_ti_sysbios_knl_Clock_Object__DESC__C};
place at address mem:0x00002258 {readonly section .const_ti_sysbios_knl_Semaphore_eventSync__C};
place at address mem:0x0000204c {readonly section .const_ti_sysbios_gates_GateMutex_Module__FXNS__C};
place at address mem:0x00002284 {readonly section .const_ti_sysbios_family_arm_m3_Hwi_Module__id__C};
place at address mem:0x00002280 {readonly section .const_ti_sysbios_family_arm_cc26xx_Timer_Module__id__C};
place at address mem:0x00002244 {readonly section .const_ti_sysbios_knl_Mailbox_Object__table__C};
place at address mem:0x0000220c {readonly section .const_ti_sysbios_family_arm_m3_Hwi_Object__table__C};
place at address mem:0x000021b0 {readonly section .const_ti_sysbios_knl_Swi_Object__DESC__C};
place at address mem:0x000022fc {readonly section .const_xdc_runtime_Text_charCnt__C};
place at address mem:0x000022ac {readonly section .const_xdc_runtime_Error_raiseHook__C};
place at address mem:0x0000231c {readonly section .const_ti_sysbios_rom_ROM_ti_sysbios_family_arm_cc26xx_Timer_start__E};
place at address mem:0x00002234 {readonly section .const_ti_sysbios_heaps_HeapMem_Object__table__C};
place at address mem:0x000022a8 {readonly section .const_xdc_runtime_Error_policyFxn__C};
place at address mem:0x00002304 {readonly section .const_ti_sysbios_rom_ROM_ti_sysbios_family_arm_cc26xx_Timer_getCount64__E};
place at address mem:0x00002290 {readonly section .const_xdc_runtime_Startup_firstFxns__C};
place at address mem:0x000022e8 {readonly section .const_xdc_runtime_Text_charTab__C};
place at address mem:0x00002320 {readonly section .const_ti_sysbios_rom_ROM_ti_sysbios_family_arm_cc26xx_TimestampProvider_get32__E};
place at address mem:0x000022f8 {readonly section .const_xdc_runtime_Error_maxDepth__C};
place at address mem:0x00002308 {readonly section .const_ti_sysbios_rom_ROM_ti_sysbios_family_arm_cc26xx_Timer_getCurrentTick__E};
place at address mem:0x00002224 {readonly section .const_ti_sysbios_family_arm_m3_TaskSupport_stackAlignment__C};
place at address mem:0x00002204 {readonly section .const_ti_sysbios_family_arm_m3_Hwi_NUM_INTERRUPTS__C};
place at address mem:0x0000223c {readonly section .const_ti_sysbios_knl_Clock_triggerClock__C};
place at address mem:0x00002260 {readonly section .const_ti_sysbios_knl_Swi_Object__table__C};
place at address mem:0x000022fa {readonly section .const_xdc_runtime_Memory_Module__id__C};
place at address mem:0x0000222c {readonly section .const_ti_sysbios_heaps_HeapMem_Module__gateObj__C};
place at address mem:0x000021f8 {readonly section .const_ti_sysbios_family_arm_cc26xx_Timer_startupNeeded__C};
place at address mem:0x00002170 {readonly section .const_ti_sysbios_knl_Queue_Object__DESC__C};
place at address mem:0x000021d0 {readonly section .const_ti_sysbios_knl_Task_Object__DESC__C};
place at address mem:0x000022a0 {readonly section .const_xdc_runtime_Assert_E_assertFailed__C};
place at address mem:0x00002286 {readonly section .const_ti_sysbios_gates_GateHwi_Module__id__C};
place at address mem:0x000022b4 {readonly section .const_xdc_runtime_IHeap_Interface__BASE__C};
place at address mem:0x000022d8 {readonly section .const_xdc_runtime_SysCallback_exitFxn__C};
place at address mem:0x0000228a {readonly section .const_ti_sysbios_heaps_HeapMem_Module__id__C};
place at address mem:0x00002214 {readonly section .const_ti_sysbios_family_arm_m3_Hwi_excHandlerFunc__C};
place at address mem:0x00002000 {readonly section .const_ti_sysbios_heaps_HeapMem_Module__FXNS__C};
place at address mem:0x000022e4 {readonly section .const_xdc_runtime_System_maxAtexitHandlers__C};
place at address mem:0x0000224c {readonly section .const_ti_sysbios_knl_Queue_Object__count__C};
place at address mem:0x0000226c {readonly section .const_ti_sysbios_knl_Task_Object__table__C};
place at address mem:0x00002150 {readonly section .const_ti_sysbios_knl_Mailbox_Object__DESC__C};
place at address mem:0x00002218 {readonly section .const_ti_sysbios_family_arm_m3_Hwi_nullIsrFunc__C};
place at address mem:0x0000228e {readonly section .const_ti_sysbios_knl_Clock_tickMode__C};
place at address mem:0x00002288 {readonly section .const_ti_sysbios_gates_GateMutex_Module__id__C};
place at address mem:0x00002264 {readonly section .const_ti_sysbios_knl_Swi_numPriorities__C};
place at address mem:0x0000227c {readonly section .const_ti_sysbios_knl_Task_numConstructedTasks__C};
place at address mem:0x000022c4 {readonly section .const_xdc_runtime_Startup_maxPasses__C};
place at address mem:0x0000228c {readonly section .const_ti_sysbios_knl_Task_initStackFlag__C};
place at address mem:0x000022dc {readonly section .const_xdc_runtime_System_abortFxn__C};
place at address mem:0x00002028 {readonly section .const_ti_sysbios_gates_GateHwi_Module__FXNS__C};
place at address mem:0x000020d0 {readonly section .const_ti_sysbios_hal_Hwi_Object__DESC__C};
place at address mem:0x00002220 {readonly section .const_ti_sysbios_family_arm_m3_Hwi_priGroup__C};
place at address mem:0x000022a4 {readonly section .const_xdc_runtime_Error_E_memory__C};
place at address mem:0x000021fc {readonly section .const_ti_sysbios_family_arm_m3_Hwi_E_alreadyDefined__C};
place at address mem:0x00002250 {readonly section .const_ti_sysbios_knl_Queue_Object__table__C};
place at address mem:0x00002254 {readonly section .const_ti_sysbios_knl_Semaphore_eventPost__C};
place at address mem:0x000022e0 {readonly section .const_xdc_runtime_System_exitFxn__C};
place at address mem:0x00002314 {readonly section .const_ti_sysbios_rom_ROM_ti_sysbios_family_arm_cc26xx_Timer_setNextTick__E};
place at address mem:0x00002238 {readonly section .const_ti_sysbios_heaps_HeapMem_reqAlign__C};
place at address mem:0x000022c8 {readonly section .const_xdc_runtime_Startup_sfxnRts__C};
place at address mem:0x00002190 {readonly section .const_ti_sysbios_knl_Semaphore_Object__DESC__C};
place at address mem:0x00002090 {readonly section .const_ti_sysbios_gates_GateHwi_Object__DESC__C};
place at address mem:0x00002230 {readonly section .const_ti_sysbios_heaps_HeapMem_Object__count__C};
place at address mem:0x0000221c {readonly section .const_ti_sysbios_family_arm_m3_Hwi_numSparseInterrupts__C};
place at address mem:0x00002248 {readonly section .const_ti_sysbios_knl_Mailbox_maxTypeAlign__C};
place at address mem:0x00002282 {readonly section .const_ti_sysbios_family_arm_cc26xx_TimestampProvider_useClockTimer__C};
place at address mem:0x0000232c {readonly section .const_ti_sysbios_rom_ROM_xdc_runtime_System_SupportProxy_exit__E};
place at address mem:0x00002270 {readonly section .const_ti_sysbios_knl_Task_allBlockedFunc__C};
place at address mem:0x00002328 {readonly section .const_ti_sysbios_rom_ROM_xdc_runtime_System_SupportProxy_abort__E};
place at address mem:0x00002240 {readonly section .const_ti_sysbios_knl_Mailbox_Object__count__C};
place at address mem:0x000022f0 {readonly section .const_xdc_runtime_Text_nameStatic__C};
place at address mem:0x00002324 {readonly section .const_ti_sysbios_rom_ROM_xdc_runtime_Startup_getState__I};
place at address mem:0x00002278 {readonly section .const_ti_sysbios_knl_Task_defaultStackSize__C};
place at address mem:0x000022b0 {readonly section .const_xdc_runtime_IGateProvider_Interface__BASE__C};
place at address mem:0x00002200 {readonly section .const_ti_sysbios_family_arm_m3_Hwi_E_hwiLimitExceeded__C};
place at address mem:0x000022d0 {readonly section .const_xdc_runtime_Startup_startModsFxn__C};
place at address mem:0x00002070 {readonly section .const_ti_sysbios_family_arm_m3_Hwi_Object__DESC__C};
place at address mem:0x000022ec {readonly section .const_xdc_runtime_Text_nameEmpty__C};
place at address mem:0x00002208 {readonly section .const_ti_sysbios_family_arm_m3_Hwi_Object__count__C};
place at address mem:0x000022d4 {readonly section .const_xdc_runtime_SysCallback_abortFxn__C};
place at address mem:0x00002274 {readonly section .const_ti_sysbios_knl_Task_defaultStackHeap__C};
place at address mem:0x00002210 {readonly section .const_ti_sysbios_family_arm_m3_Hwi_ccr__C};
place at address mem:0x00002228 {readonly section .const_ti_sysbios_heaps_HeapMem_E_memory__C};
place at address mem:0x00002268 {readonly section .const_ti_sysbios_knl_Task_Object__count__C};
place at address mem:0x000020f0 {readonly section .const_ti_sysbios_heaps_HeapMem_Object__DESC__C};
place at address mem:0x000022f4 {readonly section .const_xdc_runtime_Text_nameUnknown__C};
place at address mem:0x000022bc {readonly section .const_xdc_runtime_Memory_defaultHeapInstance__C};
place at address mem:0x00002318 {readonly section .const_ti_sysbios_rom_ROM_ti_sysbios_family_arm_cc26xx_Timer_setThreshold__I};
place at address mem:0x000022cc {readonly section .const_xdc_runtime_Startup_sfxnTab__C};
place at address mem:0x20000178 {readwrite section .data_ti_sysbios_knl_Clock_Module__state__V};
place at address mem:0x200001ec {readwrite section .data_ti_sysbios_family_arm_cc26xx_TimestampProvider_Module__state__V};
place at address mem:0x200001f0 {readwrite section .data_xdc_runtime_Startup_Module__state__V};
place at address mem:0x200001a4 {readwrite section .data_ti_sysbios_BIOS_Module__state__V};
place at address mem:0x200001c8 {readwrite section .data_ti_sysbios_knl_Swi_Module__state__V};
place at address mem:0x20000100 {readwrite section .data_ti_sysbios_knl_Task_Module__state__V};
place at address mem:0x20000200 {readwrite section .data_xdc_runtime_Memory_Module__state__V};
place at address mem:0x200001f8 {readwrite section .data_xdc_runtime_System_Module__state__V};
place at address mem:0x20000144 {readwrite section .data_ti_sysbios_family_arm_m3_Hwi_Module__state__V};
place at address mem:0x20000204 {readwrite section .data_xdc_runtime_Error_Module__state__V};
place at address mem:0x200001e4 {readwrite section .data_ti_sysbios_family_arm_cc26xx_Timer_Module__state__V};
