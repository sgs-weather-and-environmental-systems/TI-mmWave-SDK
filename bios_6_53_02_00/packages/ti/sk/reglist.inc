;/*
; *
; * Copyright (c) 2012, Texas Instruments Incorporated
; * All rights reserved.
; *
; *  Redistribution and use in source and binary forms, with or without
; *  modification, are permitted provided that the following conditions
; *  are met:
; *
; *    Redistributions of source code must retain the above copyright
; *    notice, this list of conditions and the following disclaimer.
; *
; *    Redistributions in binary form must reproduce the above copyright
; *    notice, this list of conditions and the following disclaimer in the
; *    documentation and/or other materials provided with the
; *    distribution.
; *
; *    Neither the name of Texas Instruments Incorporated nor the names of
; *    its contributors may be used to endorse or promote products derived
; *    from this software without specific prior written permission.
; *
; *  THIS SOFTWARE IS PROVIDED BY THE COPYRIGHT HOLDERS AND CONTRIBUTORS
; *  "AS IS" AND ANY EXPRESS OR IMPLIED WARRANTIES, INCLUDING, BUT NOT
; *  LIMITED TO, THE IMPLIED WARRANTIES OF MERCHANTABILITY AND FITNESS FOR
; *  A PARTICULAR PURPOSE ARE DISCLAIMED. IN NO EVENT SHALL THE COPYRIGHT
; *  OWNER OR CONTRIBUTORS BE LIABLE FOR ANY DIRECT, INDIRECT, INCIDENTAL,
; *  SPECIAL, EXEMPLARY, OR CONSEQUENTIAL DAMAGES (INCLUDING, BUT NOT
; *  LIMITED TO, PROCUREMENT OF SUBSTITUTE GOODS OR SERVICES; LOSS OF USE,
; *  DATA, OR PROFITS; OR BUSINESS INTERRUPTION) HOWEVER CAUSED AND ON ANY
; *  THEORY OF LIABILITY, WHETHER IN CONTRACT, STRICT LIABILITY, OR TORT
; *  (INCLUDING NEGLIGENCE OR OTHERWISE) ARISING IN ANY WAY OUT OF THE USE
; *  OF THIS SOFTWARE, EVEN IF ADVISED OF THE POSSIBILITY OF SUCH DAMAGE.
; *
;*/
; Generated by regs.pl
 .asg 0x01840040, L1DCFG        ; L1D Configuration Register
 .asg 0x01840044, L1DCC         ; L1D Cache Control
 .asg 0x01841040, CPUARBD       ; CPU Arb Control
 .asg 0x01841044, IDMAARBD      ; IDMA Arb Control
 .asg 0x01841048, SDMAARBD      ; SDMA Arb Control
 .asg 0x0184104C, UCARBD        ; User Coherence Arb Control
 .asg 0x01842040, L1DEMUCMD     ; L1D Emulation Command
 .asg 0x01844030, L1DWIBAR      ; L1D Block Wb-Inv Base Address Register
 .asg 0x01844034, L1DWIWC       ; L1D Block Wb-Inv Word Count
 .asg 0x01844040, L1DWBAR       ; L1D Block Writeback Base Address Register
 .asg 0x01844044, L1DWWC        ; L1D Block Writeback Word Count
 .asg 0x01844048, L1DIBAR       ; L1D Block Invalidate Base Address Register
 .asg 0x0184404C, L1DIWC        ; L1D Block Invalidate Word Count
 .asg 0x01845040, L1DWB         ; L1D Global Writeback
 .asg 0x01845044, L1DWBINV      ; L1D Global Writeback Invalidate
 .asg 0x01845048, L1DINV        ; L1D Global Invalidate
 .asg 0x0184AC00, L1DMPFAR      ; L1D Memory Protection Fault Address Register
 .asg 0x0184AC04, L1DMPFSR      ; L1D Memory Protection Fault Status Register
 .asg 0x0184AC08, L1DMPFCR      ; L1D Memory Protection Fault Command Register
 .asg 0x0184AD00, L1DMPLK0      ; L1D Memory Protection Lock Bits 31:0
 .asg 0x0184AD04, L1DMPLK1      ; L1D Memory Protection Lock Bits 63:32
 .asg 0x0184AD08, L1DMPLK2      ; L1D Memory Protection Lock Bits 95:64
 .asg 0x0184AD0C, L1DMPLK3      ; L1D Memory Protection Lock Bits 127:96
 .asg 0x0184AD10, L1DMPLKCMD    ; L1D Memory Protection Lock Command
 .asg 0x0184AD14, L1DMPLKSTAT   ; L1D Memory Protection Lock Status
 .asg 0x0184AE00, L1DMPPA0      ; L1D Memory Protection Page Attribute
 .asg 0x0184AE04, L1DMPPA1      ; L1D Memory Protection Page Attribute
 .asg 0x0184AE08, L1DMPPA2      ; L1D Memory Protection Page Attribute
 .asg 0x0184AE0C, L1DMPPA3      ; L1D Memory Protection Page Attribute
 .asg 0x0184AE10, L1DMPPA4      ; L1D Memory Protection Page Attribute
 .asg 0x0184AE14, L1DMPPA5      ; L1D Memory Protection Page Attribute
 .asg 0x0184AE18, L1DMPPA6      ; L1D Memory Protection Page Attribute
 .asg 0x0184AE1C, L1DMPPA7      ; L1D Memory Protection Page Attribute
 .asg 0x0184AE20, L1DMPPA8      ; L1D Memory Protection Page Attribute
 .asg 0x0184AE24, L1DMPPA9      ; L1D Memory Protection Page Attribute
 .asg 0x0184AE28, L1DMPPA10     ; L1D Memory Protection Page Attribute
 .asg 0x0184AE2C, L1DMPPA11     ; L1D Memory Protection Page Attribute
 .asg 0x0184AE30, L1DMPPA12     ; L1D Memory Protection Page Attribute
 .asg 0x0184AE34, L1DMPPA13     ; L1D Memory Protection Page Attribute
 .asg 0x0184AE38, L1DMPPA14     ; L1D Memory Protection Page Attribute
 .asg 0x0184AE3C, L1DMPPA15     ; L1D Memory Protection Page Attribute
 .asg 0x0184AE40, L1DMPPA16     ; L1D Memory Protection Page Attribute
 .asg 0x0184AE44, L1DMPPA17     ; L1D Memory Protection Page Attribute
 .asg 0x0184AE48, L1DMPPA18     ; L1D Memory Protection Page Attribute
 .asg 0x0184AE4C, L1DMPPA19     ; L1D Memory Protection Page Attribute
 .asg 0x0184AE50, L1DMPPA20     ; L1D Memory Protection Page Attribute
 .asg 0x0184AE54, L1DMPPA21     ; L1D Memory Protection Page Attribute
 .asg 0x0184AE58, L1DMPPA22     ; L1D Memory Protection Page Attribute
 .asg 0x0184AE5C, L1DMPPA23     ; L1D Memory Protection Page Attribute
 .asg 0x0184AE60, L1DMPPA24     ; L1D Memory Protection Page Attribute
 .asg 0x0184AE64, L1DMPPA25     ; L1D Memory Protection Page Attribute
 .asg 0x0184AE68, L1DMPPA26     ; L1D Memory Protection Page Attribute
 .asg 0x0184AE6C, L1DMPPA27     ; L1D Memory Protection Page Attribute
 .asg 0x0184AE70, L1DMPPA28     ; L1D Memory Protection Page Attribute
 .asg 0x0184AE74, L1DMPPA29     ; L1D Memory Protection Page Attribute
 .asg 0x0184AE78, L1DMPPA30     ; L1D Memory Protection Page Attribute
 .asg 0x0184AE7C, L1DMPPA31     ; L1D Memory Protection Page Attribute
 .asg 0x01BC0020, IAR_ADD       ; Indirect Register Address
 .asg 0x01BC0024, IAR_DAT       ; Indirect Register Write Data
 .asg 0x01BC0028, DP_EVT        ; Event Status Register for Analysis
 .asg 0x01BC002C, DP_PID        ; Claim/Enable/Ownership for Analysis
 .asg 0x01BC0030, DP_PC         ; PC Captured status register
 .asg 0x01BC0034, DP_SPL_PC     ; SPLOOP PC
 .asg 0x01BC0038, DP_SPL_STAT   ; SPLOOP Captured status register
 .asg 0x01BC0130, PIN_MGR_0     ; Pin Manager Control 0
 .asg 0x01BC0134, PIN_MGR_1     ; Pin Manager Control 1
 .asg 0x01BC0138, PIN_MGR_2     ; Pin Manager Control 2
 .asg 0x01BC013C, TR_CNTL       ; Trace Control Register
 .asg 0x01BC0140, TP_COUNTER    ; Trace Port Counter Register
 .asg 0x01BC014C, TF_CNTL       ; Trace Formatter Control Register
 .asg 0x01BC0160, PIN_OBSV      ; Pin Observation Register
 .asg 0x01BC0164, PIN_MGR_3     ; Pin Manager Control 3
 .asg 0x01820000, IDMA0_STAT    ; IDMA0 Status Register
 .asg 0x01820004, IDMA0_MASK    ; IDMA0 Mask Register
 .asg 0x01820008, IDMA0_SOURCE  ; IDMA0 Source Address Register
 .asg 0x0182000C, IDMA0_DEST    ; IDMA0 Destination Address Register
 .asg 0x01820010, IDMA0_COUNT   ; IDMA0 Window Count Register
 .asg 0x01820100, IDMA1_STAT    ; IDMA1 Status Register
 .asg 0x01820108, IDMA1_SOURCE  ; IDMA1 Source Address Register
 .asg 0x0182010C, IDMA1_DEST    ; IDMA1 Destination Address Register
 .asg 0x01820110, IDMA1_COUNT   ; IDMA1 Window Count Register
 .asg 0x01820180, IDMA_EMUCTL   ; IDMA Emulation Control Register
 .asg 0x01820200, CPUARBE       ; CPU Arb Control
 .asg 0x01820204, IDMAARBE      ; IDMA Arb Control
 .asg 0x01820208, SDMAARBE      ; SDMA Arb Control
 .asg 0x0182020C, MDMARBE       ; MDMA Arb Control
 .asg 0x01820300, ICFGMPFAR     ; ICFG Memory Protection Fault Address Register
 .asg 0x01820304, ICFGMPFSR     ; ICFG Memory Protection Fault Status Register
 .asg 0x01820308, ICFGMPFCR     ; ICFG Memory Protection Fault Command Register
 .asg 0x01820400, BUSERR        ; Bus Access Error
 .asg 0x01820404, BUSERRCLR     ; Bus Access Error Clear
 .asg 0x01840020, L1PCFG        ; L1P Configuration Register
 .asg 0x01840024, L1PCC         ; L1P Cache Control
 .asg 0x01842020, L1PEMUCMD     ; L1P Emulation Command
 .asg 0x01844020, L1PIBAR       ; L1P Block Invalidate Base Address Register
 .asg 0x01844024, L1PIWC        ; L1P Block Invalidate Word Count
 .asg 0x01845028, L1PINV        ; L1P Global Invalidate
 .asg 0x01846404, L1PEDSTAT     ; L1P Error Detection Status
 .asg 0x01846408, L1PEDCMD      ; L1P Error Detection Command
 .asg 0x0184640C, L1PEDADDR     ; L2 Error Detection Address
 .asg 0x0184A400, L1PMPFAR      ; L1P Memory Protection Fault Address Register
 .asg 0x0184A404, L1PMPFSR      ; L1P Memory Protection Fault Status Register
 .asg 0x0184A408, L1PMPFCR      ; L1P Memory Protection Fault Command Register
 .asg 0x0184A500, L1PMPLK0      ; L1P Memory Protection Lock Bits 31:0
 .asg 0x0184A504, L1PMPLK1      ; L1P Memory Protection Lock Bits 63:32
 .asg 0x0184A508, L1PMPLK2      ; L1P Memory Protection Lock Bits 95:64
 .asg 0x0184A50C, L1PMPLK3      ; L1P Memory Protection Lock Bits 127:96
 .asg 0x0184A510, L1PMPLKCMD    ; L1P Memory Protection Lock Command
 .asg 0x0184A514, L1PMPLKSTAT   ; L1P Memory Protection Lock Status
 .asg 0x0184A600, L1PMPPA0      ; L1P Memory Protection Page Attribute
 .asg 0x0184A604, L1PMPPA1      ; L1P Memory Protection Page Attribute
 .asg 0x0184A608, L1PMPPA2      ; L1P Memory Protection Page Attribute
 .asg 0x0184A60C, L1PMPPA3      ; L1P Memory Protection Page Attribute
 .asg 0x0184A610, L1PMPPA4      ; L1P Memory Protection Page Attribute
 .asg 0x0184A614, L1PMPPA5      ; L1P Memory Protection Page Attribute
 .asg 0x0184A618, L1PMPPA6      ; L1P Memory Protection Page Attribute
 .asg 0x0184A61C, L1PMPPA7      ; L1P Memory Protection Page Attribute
 .asg 0x0184A620, L1PMPPA8      ; L1P Memory Protection Page Attribute
 .asg 0x0184A624, L1PMPPA9      ; L1P Memory Protection Page Attribute
 .asg 0x0184A628, L1PMPPA10     ; L1P Memory Protection Page Attribute
 .asg 0x0184A62C, L1PMPPA11     ; L1P Memory Protection Page Attribute
 .asg 0x0184A630, L1PMPPA12     ; L1P Memory Protection Page Attribute
 .asg 0x0184A634, L1PMPPA13     ; L1P Memory Protection Page Attribute
 .asg 0x0184A638, L1PMPPA14     ; L1P Memory Protection Page Attribute
 .asg 0x0184A63C, L1PMPPA15     ; L1P Memory Protection Page Attribute
 .asg 0x0184A640, L1PMPPA16     ; L1P Memory Protection Page Attribute
 .asg 0x0184A644, L1PMPPA17     ; L1P Memory Protection Page Attribute
 .asg 0x0184A648, L1PMPPA18     ; L1P Memory Protection Page Attribute
 .asg 0x0184A64C, L1PMPPA19     ; L1P Memory Protection Page Attribute
 .asg 0x0184A650, L1PMPPA20     ; L1P Memory Protection Page Attribute
 .asg 0x0184A654, L1PMPPA21     ; L1P Memory Protection Page Attribute
 .asg 0x0184A658, L1PMPPA22     ; L1P Memory Protection Page Attribute
 .asg 0x0184A65C, L1PMPPA23     ; L1P Memory Protection Page Attribute
 .asg 0x0184A660, L1PMPPA24     ; L1P Memory Protection Page Attribute
 .asg 0x0184A664, L1PMPPA25     ; L1P Memory Protection Page Attribute
 .asg 0x0184A668, L1PMPPA26     ; L1P Memory Protection Page Attribute
 .asg 0x0184A66C, L1PMPPA27     ; L1P Memory Protection Page Attribute
 .asg 0x0184A670, L1PMPPA28     ; L1P Memory Protection Page Attribute
 .asg 0x0184A674, L1PMPPA29     ; L1P Memory Protection Page Attribute
 .asg 0x0184A678, L1PMPPA30     ; L1P Memory Protection Page Attribute
 .asg 0x0184A67C, L1PMPPA31     ; L1P Memory Protection Page Attribute
 .asg 0x01800000, EVTFLAG0      ; System Event Flag Register 0
 .asg 0x01800004, EVTFLAG1      ; System Event Flag Register 1
 .asg 0x01800008, EVTFLAG2      ; System Event Flag Register 2
 .asg 0x0180000C, EVTFLAG3      ; System Event Flag Register 3
 .asg 0x01800020, EVTSET0       ; System Event Set Register 0
 .asg 0x01800024, EVTSET1       ; System Event Set Register 1
 .asg 0x01800028, EVTSET2       ; System Event Set Register 2
 .asg 0x0180002C, EVTSET3       ; System Event Set Register 3
 .asg 0x01800040, EVTCLR0       ; System Event Clear Register 0
 .asg 0x01800044, EVTCLR1       ; System Event Clear Register 1
 .asg 0x01800048, EVTCLR2       ; System Event Clear Register 2
 .asg 0x0180004C, EVTCLR3       ; System Event Clear Register 3
 .asg 0x01800080, EVTMASK0      ; Event Mask Register 0
 .asg 0x01800084, EVTMASK1      ; Event Mask Register 1
 .asg 0x01800088, EVTMASK2      ; Event Mask Register 2
 .asg 0x0180008C, EVTMASK3      ; Event Mask Register 3
 .asg 0x018000A0, MEVTFLAG0     ; Masked Event Flag Register 0
 .asg 0x018000A4, MEVTFLAG1     ; Masked Event Flag Register 1
 .asg 0x018000A8, MEVTFLAG2     ; Masked Event Flag Register 2
 .asg 0x018000AC, MEVTFLAG3     ; Masked Event Flag Register 3
 .asg 0x018000C0, EXPMASK0      ; Exception Mask Register 0
 .asg 0x018000C4, EXPMASK1      ; Exception Mask Register 1
 .asg 0x018000C8, EXPMASK2      ; Exception Mask Register 2
 .asg 0x018000CC, EXPMASK3      ; Exception Mask Register 3
 .asg 0x018000E0, MEXPFLAG0     ; System Event FLAG Register 0
 .asg 0x018000E4, MEXPFLAG1     ; System Event FLAG Register 1
 .asg 0x018000E8, MEXPFLAG2     ; System Event FLAG Register 2
 .asg 0x018000EC, MEXPFLAG3     ; System Event FLAG Register 3
 .asg 0x01800104, INTMUX1       ; CPU Interrupt Selector Register 1
 .asg 0x01800108, INTMUX2       ; CPU Interrupt Selector Register 2
 .asg 0x0180010C, INTMUX3       ; CPU Interrupt Selector Register 3
 .asg 0x01800140, AEGMUX0       ; AEG Selector Register 0
 .asg 0x01800144, AEGMUX1       ; AEG Selector Register 1
 .asg 0x01800180, INTXSTAT      ; Interrupt Exception Status Register
 .asg 0x01800184, INTXCLR       ; Interrupt Exception Clear Register
 .asg 0x01800188, INTDMASK      ; Dropped Interrupt Mask Register
 .asg 0x018001C0, EVTASRT       ; Event Assert Register
 .asg 0x01810000, PDCCMD        ; Powerdown Command Register
 .asg 0x01811000, UID0          ; Unique ID bits 31:0
 .asg 0x01811004, UID1          ; Unique ID bits 63:32
 .asg 0x01811008, UID2          ; Unique ID bits 95:64
 .asg 0x0181100C, UID3          ; Unique ID bits 127:96
 .asg 0x01811010, UID4          ; Unique ID bits 159:128
 .asg 0x01811014, UID5          ; Unique ID bits 191:160
 .asg 0x01811018, UID6          ; Unique ID bits 223:192
 .asg 0x0181101C, UID7          ; Unique ID bits 255:224
 .asg 0x01812000, REVID         ; Revision ID Register
 .asg 0x01840000, L2CFG         ; L2 cache configuration register
 .asg 0x01841000, CPUARBU       ; CPU Arb Control
 .asg 0x01841004, IDMAARBU      ; IDMA Arb Control
 .asg 0x01841008, SDMAARBU      ; SDMA Arb Control
 .asg 0x0184100C, UCARBU        ; User Coherence Arb Control
 .asg 0x01842000, L2EMUCMD      ; L2 Emulation Command Register
 .asg 0x01844000, L2WBAR        ; L2 block writeback base address
 .asg 0x01844004, L2WWC         ; L2 block writeback word count
 .asg 0x01844010, L2WIBAR       ; L2 block wbinv base address
 .asg 0x01844014, L2WIWC        ; L2 block wbinv word count
 .asg 0x01844018, L2IBAR        ; L2 block invalidate base address
 .asg 0x0184401C, L2IWC         ; L2 block invalidate word count
 .asg 0x01845000, L2WB          ; L2 global writeback
 .asg 0x01845004, L2WBINV       ; L2 global writeback invalidate
 .asg 0x01845008, L2INV         ; L2 global invalidate
 .asg 0x01846004, L2EDSTAT      ; L2 EDC Status Register
 .asg 0x01846008, L2EDCMD       ; L2 EDC Command Register
 .asg 0x0184600C, L2EDADDR      ; L2 EDC Error Address
 .asg 0x01846010, L2EDPEN0      ; L2 EDC Page Enables, UMAP 0
 .asg 0x01846014, L2EDPEN1      ; L2 EDC Page Enables, UMAP 1
 .asg 0x01846018, L2EDCPEC      ; L2 EDC correctable parity count
 .asg 0x0184601C, L2EDNPEC      ; L2 EDC non-correctable parity count
 .asg 0x01848000, MAR0          ; Memory Attribute Register
 .asg 0x01848004, MAR1          ; Memory Attribute Register
 .asg 0x01848008, MAR2          ; Memory Attribute Register
 .asg 0x0184800C, MAR3          ; Memory Attribute Register
 .asg 0x01848010, MAR4          ; Memory Attribute Register
 .asg 0x01848014, MAR5          ; Memory Attribute Register
 .asg 0x01848018, MAR6          ; Memory Attribute Register
 .asg 0x0184801C, MAR7          ; Memory Attribute Register
 .asg 0x01848020, MAR8          ; Memory Attribute Register
 .asg 0x01848024, MAR9          ; Memory Attribute Register
 .asg 0x01848028, MAR10         ; Memory Attribute Register
 .asg 0x0184802C, MAR11         ; Memory Attribute Register
 .asg 0x01848030, MAR12         ; Memory Attribute Register
 .asg 0x01848034, MAR13         ; Memory Attribute Register
 .asg 0x01848038, MAR14         ; Memory Attribute Register
 .asg 0x0184803C, MAR15         ; Memory Attribute Register
 .asg 0x01848040, MAR16         ; Memory Attribute Register
 .asg 0x01848044, MAR17         ; Memory Attribute Register
 .asg 0x01848048, MAR18         ; Memory Attribute Register
 .asg 0x0184804C, MAR19         ; Memory Attribute Register
 .asg 0x01848050, MAR20         ; Memory Attribute Register
 .asg 0x01848054, MAR21         ; Memory Attribute Register
 .asg 0x01848058, MAR22         ; Memory Attribute Register
 .asg 0x0184805C, MAR23         ; Memory Attribute Register
 .asg 0x01848060, MAR24         ; Memory Attribute Register
 .asg 0x01848064, MAR25         ; Memory Attribute Register
 .asg 0x01848068, MAR26         ; Memory Attribute Register
 .asg 0x0184806C, MAR27         ; Memory Attribute Register
 .asg 0x01848070, MAR28         ; Memory Attribute Register
 .asg 0x01848074, MAR29         ; Memory Attribute Register
 .asg 0x01848078, MAR30         ; Memory Attribute Register
 .asg 0x0184807C, MAR31         ; Memory Attribute Register
 .asg 0x01848080, MAR32         ; Memory Attribute Register
 .asg 0x01848084, MAR33         ; Memory Attribute Register
 .asg 0x01848088, MAR34         ; Memory Attribute Register
 .asg 0x0184808C, MAR35         ; Memory Attribute Register
 .asg 0x01848090, MAR36         ; Memory Attribute Register
 .asg 0x01848094, MAR37         ; Memory Attribute Register
 .asg 0x01848098, MAR38         ; Memory Attribute Register
 .asg 0x0184809C, MAR39         ; Memory Attribute Register
 .asg 0x018480A0, MAR40         ; Memory Attribute Register
 .asg 0x018480A4, MAR41         ; Memory Attribute Register
 .asg 0x018480A8, MAR42         ; Memory Attribute Register
 .asg 0x018480AC, MAR43         ; Memory Attribute Register
 .asg 0x018480B0, MAR44         ; Memory Attribute Register
 .asg 0x018480B4, MAR45         ; Memory Attribute Register
 .asg 0x018480B8, MAR46         ; Memory Attribute Register
 .asg 0x018480BC, MAR47         ; Memory Attribute Register
 .asg 0x018480C0, MAR48         ; Memory Attribute Register
 .asg 0x018480C4, MAR49         ; Memory Attribute Register
 .asg 0x018480C8, MAR50         ; Memory Attribute Register
 .asg 0x018480CC, MAR51         ; Memory Attribute Register
 .asg 0x018480D0, MAR52         ; Memory Attribute Register
 .asg 0x018480D4, MAR53         ; Memory Attribute Register
 .asg 0x018480D8, MAR54         ; Memory Attribute Register
 .asg 0x018480DC, MAR55         ; Memory Attribute Register
 .asg 0x018480E0, MAR56         ; Memory Attribute Register
 .asg 0x018480E4, MAR57         ; Memory Attribute Register
 .asg 0x018480E8, MAR58         ; Memory Attribute Register
 .asg 0x018480EC, MAR59         ; Memory Attribute Register
 .asg 0x018480F0, MAR60         ; Memory Attribute Register
 .asg 0x018480F4, MAR61         ; Memory Attribute Register
 .asg 0x018480F8, MAR62         ; Memory Attribute Register
 .asg 0x018480FC, MAR63         ; Memory Attribute Register
 .asg 0x01848100, MAR64         ; Memory Attribute Register
 .asg 0x01848104, MAR65         ; Memory Attribute Register
 .asg 0x01848108, MAR66         ; Memory Attribute Register
 .asg 0x0184810C, MAR67         ; Memory Attribute Register
 .asg 0x01848110, MAR68         ; Memory Attribute Register
 .asg 0x01848114, MAR69         ; Memory Attribute Register
 .asg 0x01848118, MAR70         ; Memory Attribute Register
 .asg 0x0184811C, MAR71         ; Memory Attribute Register
 .asg 0x01848120, MAR72         ; Memory Attribute Register
 .asg 0x01848124, MAR73         ; Memory Attribute Register
 .asg 0x01848128, MAR74         ; Memory Attribute Register
 .asg 0x0184812C, MAR75         ; Memory Attribute Register
 .asg 0x01848130, MAR76         ; Memory Attribute Register
 .asg 0x01848134, MAR77         ; Memory Attribute Register
 .asg 0x01848138, MAR78         ; Memory Attribute Register
 .asg 0x0184813C, MAR79         ; Memory Attribute Register
 .asg 0x01848140, MAR80         ; Memory Attribute Register
 .asg 0x01848144, MAR81         ; Memory Attribute Register
 .asg 0x01848148, MAR82         ; Memory Attribute Register
 .asg 0x0184814C, MAR83         ; Memory Attribute Register
 .asg 0x01848150, MAR84         ; Memory Attribute Register
 .asg 0x01848154, MAR85         ; Memory Attribute Register
 .asg 0x01848158, MAR86         ; Memory Attribute Register
 .asg 0x0184815C, MAR87         ; Memory Attribute Register
 .asg 0x01848160, MAR88         ; Memory Attribute Register
 .asg 0x01848164, MAR89         ; Memory Attribute Register
 .asg 0x01848168, MAR90         ; Memory Attribute Register
 .asg 0x0184816C, MAR91         ; Memory Attribute Register
 .asg 0x01848170, MAR92         ; Memory Attribute Register
 .asg 0x01848174, MAR93         ; Memory Attribute Register
 .asg 0x01848178, MAR94         ; Memory Attribute Register
 .asg 0x0184817C, MAR95         ; Memory Attribute Register
 .asg 0x01848180, MAR96         ; Memory Attribute Register
 .asg 0x01848184, MAR97         ; Memory Attribute Register
 .asg 0x01848188, MAR98         ; Memory Attribute Register
 .asg 0x0184818C, MAR99         ; Memory Attribute Register
 .asg 0x01848190, MAR100        ; Memory Attribute Register
 .asg 0x01848194, MAR101        ; Memory Attribute Register
 .asg 0x01848198, MAR102        ; Memory Attribute Register
 .asg 0x0184819C, MAR103        ; Memory Attribute Register
 .asg 0x018481A0, MAR104        ; Memory Attribute Register
 .asg 0x018481A4, MAR105        ; Memory Attribute Register
 .asg 0x018481A8, MAR106        ; Memory Attribute Register
 .asg 0x018481AC, MAR107        ; Memory Attribute Register
 .asg 0x018481B0, MAR108        ; Memory Attribute Register
 .asg 0x018481B4, MAR109        ; Memory Attribute Register
 .asg 0x018481B8, MAR110        ; Memory Attribute Register
 .asg 0x018481BC, MAR111        ; Memory Attribute Register
 .asg 0x018481C0, MAR112        ; Memory Attribute Register
 .asg 0x018481C4, MAR113        ; Memory Attribute Register
 .asg 0x018481C8, MAR114        ; Memory Attribute Register
 .asg 0x018481CC, MAR115        ; Memory Attribute Register
 .asg 0x018481D0, MAR116        ; Memory Attribute Register
 .asg 0x018481D4, MAR117        ; Memory Attribute Register
 .asg 0x018481D8, MAR118        ; Memory Attribute Register
 .asg 0x018481DC, MAR119        ; Memory Attribute Register
 .asg 0x018481E0, MAR120        ; Memory Attribute Register
 .asg 0x018481E4, MAR121        ; Memory Attribute Register
 .asg 0x018481E8, MAR122        ; Memory Attribute Register
 .asg 0x018481EC, MAR123        ; Memory Attribute Register
 .asg 0x018481F0, MAR124        ; Memory Attribute Register
 .asg 0x018481F4, MAR125        ; Memory Attribute Register
 .asg 0x018481F8, MAR126        ; Memory Attribute Register
 .asg 0x018481FC, MAR127        ; Memory Attribute Register
 .asg 0x01848200, MAR128        ; Memory Attribute Register
 .asg 0x01848204, MAR129        ; Memory Attribute Register
 .asg 0x01848208, MAR130        ; Memory Attribute Register
 .asg 0x0184820C, MAR131        ; Memory Attribute Register
 .asg 0x01848210, MAR132        ; Memory Attribute Register
 .asg 0x01848214, MAR133        ; Memory Attribute Register
 .asg 0x01848218, MAR134        ; Memory Attribute Register
 .asg 0x0184821C, MAR135        ; Memory Attribute Register
 .asg 0x01848220, MAR136        ; Memory Attribute Register
 .asg 0x01848224, MAR137        ; Memory Attribute Register
 .asg 0x01848228, MAR138        ; Memory Attribute Register
 .asg 0x0184822C, MAR139        ; Memory Attribute Register
 .asg 0x01848230, MAR140        ; Memory Attribute Register
 .asg 0x01848234, MAR141        ; Memory Attribute Register
 .asg 0x01848238, MAR142        ; Memory Attribute Register
 .asg 0x0184823C, MAR143        ; Memory Attribute Register
 .asg 0x01848240, MAR144        ; Memory Attribute Register
 .asg 0x01848244, MAR145        ; Memory Attribute Register
 .asg 0x01848248, MAR146        ; Memory Attribute Register
 .asg 0x0184824C, MAR147        ; Memory Attribute Register
 .asg 0x01848250, MAR148        ; Memory Attribute Register
 .asg 0x01848254, MAR149        ; Memory Attribute Register
 .asg 0x01848258, MAR150        ; Memory Attribute Register
 .asg 0x0184825C, MAR151        ; Memory Attribute Register
 .asg 0x01848260, MAR152        ; Memory Attribute Register
 .asg 0x01848264, MAR153        ; Memory Attribute Register
 .asg 0x01848268, MAR154        ; Memory Attribute Register
 .asg 0x0184826C, MAR155        ; Memory Attribute Register
 .asg 0x01848270, MAR156        ; Memory Attribute Register
 .asg 0x01848274, MAR157        ; Memory Attribute Register
 .asg 0x01848278, MAR158        ; Memory Attribute Register
 .asg 0x0184827C, MAR159        ; Memory Attribute Register
 .asg 0x01848280, MAR160        ; Memory Attribute Register
 .asg 0x01848284, MAR161        ; Memory Attribute Register
 .asg 0x01848288, MAR162        ; Memory Attribute Register
 .asg 0x0184828C, MAR163        ; Memory Attribute Register
 .asg 0x01848290, MAR164        ; Memory Attribute Register
 .asg 0x01848294, MAR165        ; Memory Attribute Register
 .asg 0x01848298, MAR166        ; Memory Attribute Register
 .asg 0x0184829C, MAR167        ; Memory Attribute Register
 .asg 0x018482A0, MAR168        ; Memory Attribute Register
 .asg 0x018482A4, MAR169        ; Memory Attribute Register
 .asg 0x018482A8, MAR170        ; Memory Attribute Register
 .asg 0x018482AC, MAR171        ; Memory Attribute Register
 .asg 0x018482B0, MAR172        ; Memory Attribute Register
 .asg 0x018482B4, MAR173        ; Memory Attribute Register
 .asg 0x018482B8, MAR174        ; Memory Attribute Register
 .asg 0x018482BC, MAR175        ; Memory Attribute Register
 .asg 0x018482C0, MAR176        ; Memory Attribute Register
 .asg 0x018482C4, MAR177        ; Memory Attribute Register
 .asg 0x018482C8, MAR178        ; Memory Attribute Register
 .asg 0x018482CC, MAR179        ; Memory Attribute Register
 .asg 0x018482D0, MAR180        ; Memory Attribute Register
 .asg 0x018482D4, MAR181        ; Memory Attribute Register
 .asg 0x018482D8, MAR182        ; Memory Attribute Register
 .asg 0x018482DC, MAR183        ; Memory Attribute Register
 .asg 0x018482E0, MAR184        ; Memory Attribute Register
 .asg 0x018482E4, MAR185        ; Memory Attribute Register
 .asg 0x018482E8, MAR186        ; Memory Attribute Register
 .asg 0x018482EC, MAR187        ; Memory Attribute Register
 .asg 0x018482F0, MAR188        ; Memory Attribute Register
 .asg 0x018482F4, MAR189        ; Memory Attribute Register
 .asg 0x018482F8, MAR190        ; Memory Attribute Register
 .asg 0x018482FC, MAR191        ; Memory Attribute Register
 .asg 0x01848300, MAR192        ; Memory Attribute Register
 .asg 0x01848304, MAR193        ; Memory Attribute Register
 .asg 0x01848308, MAR194        ; Memory Attribute Register
 .asg 0x0184830C, MAR195        ; Memory Attribute Register
 .asg 0x01848310, MAR196        ; Memory Attribute Register
 .asg 0x01848314, MAR197        ; Memory Attribute Register
 .asg 0x01848318, MAR198        ; Memory Attribute Register
 .asg 0x0184831C, MAR199        ; Memory Attribute Register
 .asg 0x01848320, MAR200        ; Memory Attribute Register
 .asg 0x01848324, MAR201        ; Memory Attribute Register
 .asg 0x01848328, MAR202        ; Memory Attribute Register
 .asg 0x0184832C, MAR203        ; Memory Attribute Register
 .asg 0x01848330, MAR204        ; Memory Attribute Register
 .asg 0x01848334, MAR205        ; Memory Attribute Register
 .asg 0x01848338, MAR206        ; Memory Attribute Register
 .asg 0x0184833C, MAR207        ; Memory Attribute Register
 .asg 0x01848340, MAR208        ; Memory Attribute Register
 .asg 0x01848344, MAR209        ; Memory Attribute Register
 .asg 0x01848348, MAR210        ; Memory Attribute Register
 .asg 0x0184834C, MAR211        ; Memory Attribute Register
 .asg 0x01848350, MAR212        ; Memory Attribute Register
 .asg 0x01848354, MAR213        ; Memory Attribute Register
 .asg 0x01848358, MAR214        ; Memory Attribute Register
 .asg 0x0184835C, MAR215        ; Memory Attribute Register
 .asg 0x01848360, MAR216        ; Memory Attribute Register
 .asg 0x01848364, MAR217        ; Memory Attribute Register
 .asg 0x01848368, MAR218        ; Memory Attribute Register
 .asg 0x0184836C, MAR219        ; Memory Attribute Register
 .asg 0x01848370, MAR220        ; Memory Attribute Register
 .asg 0x01848374, MAR221        ; Memory Attribute Register
 .asg 0x01848378, MAR222        ; Memory Attribute Register
 .asg 0x0184837C, MAR223        ; Memory Attribute Register
 .asg 0x01848380, MAR224        ; Memory Attribute Register
 .asg 0x01848384, MAR225        ; Memory Attribute Register
 .asg 0x01848388, MAR226        ; Memory Attribute Register
 .asg 0x0184838C, MAR227        ; Memory Attribute Register
 .asg 0x01848390, MAR228        ; Memory Attribute Register
 .asg 0x01848394, MAR229        ; Memory Attribute Register
 .asg 0x01848398, MAR230        ; Memory Attribute Register
 .asg 0x0184839C, MAR231        ; Memory Attribute Register
 .asg 0x018483A0, MAR232        ; Memory Attribute Register
 .asg 0x018483A4, MAR233        ; Memory Attribute Register
 .asg 0x018483A8, MAR234        ; Memory Attribute Register
 .asg 0x018483AC, MAR235        ; Memory Attribute Register
 .asg 0x018483B0, MAR236        ; Memory Attribute Register
 .asg 0x018483B4, MAR237        ; Memory Attribute Register
 .asg 0x018483B8, MAR238        ; Memory Attribute Register
 .asg 0x018483BC, MAR239        ; Memory Attribute Register
 .asg 0x018483C0, MAR240        ; Memory Attribute Register
 .asg 0x018483C4, MAR241        ; Memory Attribute Register
 .asg 0x018483C8, MAR242        ; Memory Attribute Register
 .asg 0x018483CC, MAR243        ; Memory Attribute Register
 .asg 0x018483D0, MAR244        ; Memory Attribute Register
 .asg 0x018483D4, MAR245        ; Memory Attribute Register
 .asg 0x018483D8, MAR246        ; Memory Attribute Register
 .asg 0x018483DC, MAR247        ; Memory Attribute Register
 .asg 0x018483E0, MAR248        ; Memory Attribute Register
 .asg 0x018483E4, MAR249        ; Memory Attribute Register
 .asg 0x018483E8, MAR250        ; Memory Attribute Register
 .asg 0x018483EC, MAR251        ; Memory Attribute Register
 .asg 0x018483F0, MAR252        ; Memory Attribute Register
 .asg 0x018483F4, MAR253        ; Memory Attribute Register
 .asg 0x018483F8, MAR254        ; Memory Attribute Register
 .asg 0x018483FC, MAR255        ; Memory Attribute Register
 .asg 0x0184A000, L2MPFAR       ; L2 Memory Protection Fault Address Register
 .asg 0x0184A004, L2MPFSR       ; L2 Memory Protection Fault Status Register
 .asg 0x0184A008, L2MPFCR       ; L2 Memory Protection Fault Command Register
 .asg 0x0184A100, L2MPLK0       ; L2 Memory Protection Lock Bits 31:0
 .asg 0x0184A104, L2MPLK1       ; L2 Memory Protection Lock Bits 63:32
 .asg 0x0184A108, L2MPLK2       ; L2 Memory Protection Lock Bits 95:64
 .asg 0x0184A10C, L2MPLK3       ; L2 Memory Protection Lock Bits 127:96
 .asg 0x0184A110, L2MPLKCMD     ; L2 Memory Protection Lock Command
 .asg 0x0184A114, L2MPLKSTAT    ; L2 Memory Protection Lock Status
 .asg 0x0184A200, L2MPPA0       ; L2 Memory Protection Page Attribute
 .asg 0x0184A204, L2MPPA1       ; L2 Memory Protection Page Attribute
 .asg 0x0184A208, L2MPPA2       ; L2 Memory Protection Page Attribute
 .asg 0x0184A20C, L2MPPA3       ; L2 Memory Protection Page Attribute
 .asg 0x0184A210, L2MPPA4       ; L2 Memory Protection Page Attribute
 .asg 0x0184A214, L2MPPA5       ; L2 Memory Protection Page Attribute
 .asg 0x0184A218, L2MPPA6       ; L2 Memory Protection Page Attribute
 .asg 0x0184A21C, L2MPPA7       ; L2 Memory Protection Page Attribute
 .asg 0x0184A220, L2MPPA8       ; L2 Memory Protection Page Attribute
 .asg 0x0184A224, L2MPPA9       ; L2 Memory Protection Page Attribute
 .asg 0x0184A228, L2MPPA10      ; L2 Memory Protection Page Attribute
 .asg 0x0184A22C, L2MPPA11      ; L2 Memory Protection Page Attribute
 .asg 0x0184A230, L2MPPA12      ; L2 Memory Protection Page Attribute
 .asg 0x0184A234, L2MPPA13      ; L2 Memory Protection Page Attribute
 .asg 0x0184A238, L2MPPA14      ; L2 Memory Protection Page Attribute
 .asg 0x0184A23C, L2MPPA15      ; L2 Memory Protection Page Attribute
 .asg 0x0184A240, L2MPPA16      ; L2 Memory Protection Page Attribute
 .asg 0x0184A244, L2MPPA17      ; L2 Memory Protection Page Attribute
 .asg 0x0184A248, L2MPPA18      ; L2 Memory Protection Page Attribute
 .asg 0x0184A24C, L2MPPA19      ; L2 Memory Protection Page Attribute
 .asg 0x0184A250, L2MPPA20      ; L2 Memory Protection Page Attribute
 .asg 0x0184A254, L2MPPA21      ; L2 Memory Protection Page Attribute
 .asg 0x0184A258, L2MPPA22      ; L2 Memory Protection Page Attribute
 .asg 0x0184A25C, L2MPPA23      ; L2 Memory Protection Page Attribute
 .asg 0x0184A260, L2MPPA24      ; L2 Memory Protection Page Attribute
 .asg 0x0184A264, L2MPPA25      ; L2 Memory Protection Page Attribute
 .asg 0x0184A268, L2MPPA26      ; L2 Memory Protection Page Attribute
 .asg 0x0184A26C, L2MPPA27      ; L2 Memory Protection Page Attribute
 .asg 0x0184A270, L2MPPA28      ; L2 Memory Protection Page Attribute
 .asg 0x0184A274, L2MPPA29      ; L2 Memory Protection Page Attribute
 .asg 0x0184A278, L2MPPA30      ; L2 Memory Protection Page Attribute
 .asg 0x0184A27C, L2MPPA31      ; L2 Memory Protection Page Attribute
 .asg 0x0184A280, L2MPPA32      ; L2 Memory Protection Page Attribute
 .asg 0x0184A284, L2MPPA33      ; L2 Memory Protection Page Attribute
 .asg 0x0184A288, L2MPPA34      ; L2 Memory Protection Page Attribute
 .asg 0x0184A28C, L2MPPA35      ; L2 Memory Protection Page Attribute
 .asg 0x0184A290, L2MPPA36      ; L2 Memory Protection Page Attribute
 .asg 0x0184A294, L2MPPA37      ; L2 Memory Protection Page Attribute
 .asg 0x0184A298, L2MPPA38      ; L2 Memory Protection Page Attribute
 .asg 0x0184A29C, L2MPPA39      ; L2 Memory Protection Page Attribute
 .asg 0x0184A2A0, L2MPPA40      ; L2 Memory Protection Page Attribute
 .asg 0x0184A2A4, L2MPPA41      ; L2 Memory Protection Page Attribute
 .asg 0x0184A2A8, L2MPPA42      ; L2 Memory Protection Page Attribute
 .asg 0x0184A2AC, L2MPPA43      ; L2 Memory Protection Page Attribute
 .asg 0x0184A2B0, L2MPPA44      ; L2 Memory Protection Page Attribute
 .asg 0x0184A2B4, L2MPPA45      ; L2 Memory Protection Page Attribute
 .asg 0x0184A2B8, L2MPPA46      ; L2 Memory Protection Page Attribute
 .asg 0x0184A2BC, L2MPPA47      ; L2 Memory Protection Page Attribute
 .asg 0x0184A2C0, L2MPPA48      ; L2 Memory Protection Page Attribute
 .asg 0x0184A2C4, L2MPPA49      ; L2 Memory Protection Page Attribute
 .asg 0x0184A2C8, L2MPPA50      ; L2 Memory Protection Page Attribute
 .asg 0x0184A2CC, L2MPPA51      ; L2 Memory Protection Page Attribute
 .asg 0x0184A2D0, L2MPPA52      ; L2 Memory Protection Page Attribute
 .asg 0x0184A2D4, L2MPPA53      ; L2 Memory Protection Page Attribute
 .asg 0x0184A2D8, L2MPPA54      ; L2 Memory Protection Page Attribute
 .asg 0x0184A2DC, L2MPPA55      ; L2 Memory Protection Page Attribute
 .asg 0x0184A2E0, L2MPPA56      ; L2 Memory Protection Page Attribute
 .asg 0x0184A2E4, L2MPPA57      ; L2 Memory Protection Page Attribute
 .asg 0x0184A2E8, L2MPPA58      ; L2 Memory Protection Page Attribute
 .asg 0x0184A2F0, L2MPPA60      ; L2 Memory Protection Page Attribute
 .asg 0x0184A2F4, L2MPPA61      ; L2 Memory Protection Page Attribute
 .asg 0x0184A2F8, L2MPPA62      ; L2 Memory Protection Page Attribute
 .asg 0x0184A2FC, L2MPPA63      ; L2 Memory Protection Page Attribute
 .asg 0x0184C000, L2PDAEN0      ; L2 Power Down Autosleep Enable, UMAP 0
 .asg 0x0184C004, L2PDAEN1      ; L2 Power Down Autosleep Enable, UMAP 1
 .asg 0x0184C010, L2PDAPS0      ; L2 Power Down Autosleep Period Select, UMAP 0
 .asg 0x0184C014, L2PDAPS1      ; L2 Power Down Autosleep Period Select, UMAP 1
 .asg 0x0184C020, L2PDAP        ; L2 Power Down Autosleep Period
 .asg 0x0184C040, L2PDWAKE0     ; L2 Power Down Wake Command, UMAP0
 .asg 0x0184C044, L2PDWAKE1     ; L2 Power Down Wake Command, UMAP1
 .asg 0x0184C050, L2PDSLEEP0    ; L2 Power Down Sleep Command, UMAP0
 .asg 0x0184C054, L2PDSLEEP1    ; L2 Power Down Sleep Command, UMAP1
 .asg 0x0184C060, L2PDSTAT0     ; L2 Power Down Status, UMAP0
 .asg 0x0184C064, L2PDSTAT1     ; L2 Power Down Status, UMAP1
